# BMP280 register map
Vendor: Google Inc.; File version: 0.1.0
Bosch Digital Pressure Sensor
Registers are 16-bit, read, reset 0x0 unless marked. A register's access mark holds for its fields unless they carry their own. Offsets are from the block's base; lines under a group give offsets from that group; [hi:lo] are bit positions; {n}, {i} and the like mark numbered series; 'fields as' and 'values as' point back to an identical list; <NAME> marks a mode.

## Memory map
0x00000077 BMP280 size 0xFF — Bosch Digital Pressure Sensor

## BMP280 — Bosch Digital Pressure Sensor
Base 0x00000077
{0x86+2i} DigT{i} (reset mask 0xFF) (i=1..3) — Used for Celcius conversion
{0x8C+2i} DigP{i} (reset mask 0xFF) (i=1..9) — Used for Pascals conversion
0xF7 PressureMsb 8-bit — Part 1 of Pressure
0xF8 PressureLsb 8-bit — Part 2 of Pressure
0xF9 PressureXlsb 8-bit — Part 3 of Pressure
0xFA TempMsb 8-bit — Part 1 of temperature
0xFB TempLsb 8-bit — Part 2 of temperature
0xFC TempXlsb 8-bit — Final part of temperature

## Licence text in the file
Copyright (C) 2019 Google Inc. Licensed under the Apache License, Version 2.0 (the "License"); you may not use this file except in compliance with the License. You may obtain a copy of the License at http://www.apache.org/licenses/LICENSE-2.0 Unless required by applicable law or agreed to in writing, software distributed under the License is distributed on an "AS IS" BASIS, WITHOUT WARRANTIES OR CONDITIONS OF ANY KIND, either express or implied. See the License for the specific language governing permissions and limitations under the License.
