# BMP180 register map
Vendor: Google Inc.; File version: 0.1.0
Bosch Digital Temperature / Pressure Sensor
Registers are 16-bit, read, reset 0x0 unless marked. A register's access mark holds for its fields unless they carry their own. Offsets are from the block's base; lines under a group give offsets from that group; [hi:lo] are bit positions; {n}, {i} and the like mark numbered series; 'fields as' and 'values as' point back to an identical list; <NAME> marks a mode.

## Memory map
0x00000077 BMP180 size 0xFF — Bosch Digital Temperature / Pressure Sensor

## BMP180 — Bosch Digital Temperature / Pressure Sensor
Base 0x00000077
0xAA PressureCalAC1 (reset mask 0xFF) — For calibration
0xAC PressureCalAC2 (reset mask 0xFF) — For calibration
{0xA8+2i} TempCal{i} (reset mask 0xFF) (i=3..6) — For calibration
0xB6 PressureCalVB1 (reset mask 0xFF) — For calibration
0xB8 PressureCalVB2 (reset mask 0xFF) — For calibration
0xBC TempCalMC (reset mask 0xFF) — For calibration
0xBE TempCalMD (reset mask 0xFF) — For calibration
0xF4 Control 8-bit write — Register stores what the measurement type should be
0xF6 Result (reset mask 0xFF) — Register stores most recent measurement result

## Licence text in the file
Copyright (C) 2020 Google Inc. Licensed under the Apache License, Version 2.0 (the "License"); you may not use this file except in compliance with the License. You may obtain a copy of the License at http://www.apache.org/licenses/LICENSE-2.0 Unless required by applicable law or agreed to in writing, software distributed under the License is distributed on an "AS IS" BASIS, WITHOUT WARRANTIES OR CONDITIONS OF ANY KIND, either express or implied. See the License for the specific language governing permissions and limitations under the License.
