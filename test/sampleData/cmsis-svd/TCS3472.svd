# TCS3472 register map
Vendor: Google Inc.; File version: 0.1.0
Color Light-to-Digital Converter with IR Filter
Registers are 16-bit, read, reset 0x0 unless marked. A register's access mark holds for its fields unless they carry their own. Offsets are from the block's base; lines under a group give offsets from that group; [hi:lo] are bit positions; {n}, {i} and the like mark numbered series; 'fields as' and 'values as' point back to an identical list; <NAME> marks a mode.

## Memory map
0x00000029 TCS3472 size 0xFF — Color Light-to-Digital Converter with IR Filter

## TCS3472 — Color Light-to-Digital Converter with IR Filter
Base 0x00000029
0x80 enable 8-bit rw — Enable specific components of the peripheral
  [7:0] init range 0..7 — Enable RGBC and Power
    1=Power; 2=RGBC (Color)
0xB4 clear (reset mask 0xFF) — This is the ambient amount of detected light.
0xB6 red (reset mask 0xFF) — Red light as an int. Divide by ambient light to get scaled number.
0xB8 green (reset mask 0xFF) — Green light as an int. Divide by ambient light to get scaled number.
0xBA blue (reset mask 0xFF) — Blue light as an int. Divide by ambient light to get scaled number.

## Licence text in the file
Copyright (C) 2019 Google Inc. Licensed under the Apache License, Version 2.0 (the "License"); you may not use this file except in compliance with the License. You may obtain a copy of the License at http://www.apache.org/licenses/LICENSE-2.0 Unless required by applicable law or agreed to in writing, software distributed under the License is distributed on an "AS IS" BASIS, WITHOUT WARRANTIES OR CONDITIONS OF ANY KIND, either express or implied. See the License for the specific language governing permissions and limitations under the License.
