# LSM303D register map
Vendor: Google Inc.; File version: 0.1.0
STMicroelectronics accelerometer and magnetometer
Registers are 8-bit, read, reset 0x0 unless marked. A register's access mark holds for its fields unless they carry their own. Offsets are from the block's base; lines under a group give offsets from that group; [hi:lo] are bit positions; {n}, {i} and the like mark numbered series; 'fields as' and 'values as' point back to an identical list; <NAME> marks a mode.

## Memory map
0x0000001D LSM303D size 0xFF — STMicroelectronics accelerometer and magnetometer

## LSM303D — STMicroelectronics accelerometer and magnetometer
Base 0x0000001D
0x88 MagnetometerX_Low — Raw magnetometer data on X plane
0x89 MagnetometerX_High — Raw magnetometer data on X plane
0x8A MagnetometerY_Low — Raw magnetometer data on Y plane
0x8B MagnetometerY_High — Raw magnetometer data on Y plane
0x8C MagnetometerZ_Low — Raw magnetometer data on Z plane
0x8D MagnetometerZ_High — Raw magnetometer data on Z plane
0xA8 AccelerometerX_Low — Raw accelerometer data on X plane
0xA9 AccelerometerX_High — Raw accelerometer data on X plane
0xAA AccelerometerY_Low — Raw accelerometer data on Y plane
0xAB AccelerometerY_High — Raw accelerometer data on Y plane
0xAC AccelerometerZ_Low — Raw accelerometer data on Z plane
0xAD AccelerometerZ_High — Raw accelerometer data on Z plane

## Licence text in the file
Copyright (C) 2019 Google Inc. Licensed under the Apache License, Version 2.0 (the "License"); you may not use this file except in compliance with the License. You may obtain a copy of the License at http://www.apache.org/licenses/LICENSE-2.0 Unless required by applicable law or agreed to in writing, software distributed under the License is distributed on an "AS IS" BASIS, WITHOUT WARRANTIES OR CONDITIONS OF ANY KIND, either express or implied. See the License for the specific language governing permissions and limitations under the License.
