# MCP4725 register map
Vendor: Google Inc.; File version: 0.1.0
Microchip 4725 Digital-to-Analog Converter
Registers are 12-bit, read-write, reset 0x0 unless marked. A register's access mark holds for its fields unless they carry their own. Offsets are from the block's base; lines under a group give offsets from that group; [hi:lo] are bit positions; {n}, {i} and the like mark numbered series; 'fields as' and 'values as' point back to an identical list; <NAME> marks a mode.

## Memory map
0x00000062 MCP4725 size 0x60 — Microchip 4725 Digital-to-Analog Converter

## MCP4725 — Microchip 4725 Digital-to-Analog Converter
Base 0x00000062
0x40 VOut (reset mask 0xFF) — VOut = (Vcc * value) / 4096 The output is a range between 0 and Vcc with steps of Vcc/4096. In a 3.3v system, each step is 800 microvolts.
0x60 EEPROM (reset mask 0xFF) — If EEPROM is set, the saved voltage output will be loaded from power-on.
  [12:0] digitalOut range 0..12 — Only allows you to send fully on or off
    0=GND (Ground); 0xFFF=VCC (Vcc (full power))

## Licence text in the file
Copyright (C) 2019 Google Inc. Licensed under the Apache License, Version 2.0 (the "License"); you may not use this file except in compliance with the License. You may obtain a copy of the License at http://www.apache.org/licenses/LICENSE-2.0 Unless required by applicable law or agreed to in writing, software distributed under the License is distributed on an "AS IS" BASIS, WITHOUT WARRANTIES OR CONDITIONS OF ANY KIND, either express or implied. See the License for the specific language governing permissions and limitations under the License.
