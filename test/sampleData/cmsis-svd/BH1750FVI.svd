# BH1750FVI register map
Vendor: Google Inc.; File version: 0.1.0
Rohm Light Sensor
Registers are write, reset 0x0 unless marked. A register's access mark holds for its fields unless they carry their own. Offsets are from the block's base; lines under a group give offsets from that group; [hi:lo] are bit positions; {n}, {i} and the like mark numbered series; 'fields as' and 'values as' point back to an identical list; <NAME> marks a mode.

## Memory map
0x00000023 BH1750FVI size 0xFF — Rohm Light Sensor

## BH1750FVI — Rohm Light Sensor
Base 0x00000023
0x00 PowerDown — No active state
0x01 PowerOn — Waiting for measurement command
0x07 Reset — Reset data register value. Not accepted in Power Down mode.
0x10 ContinuousHResMode — Start measurement at 1lx resolution. Typically 120ms.
0x11 ContinuousHRes2Mode — Start measurement at 0.5lx resolution. Typically 120ms.
0x13 ContinuouslyLResMode — Start measurement at 4lx resolution. Typically 16ms.
0x20 OnceHResMode — Start measurement at 1lx resolution. Typically 120ms. Power Down after measurement.
0x21 OnceHRes2Mode — Start measurement at 0.5lx resolution. Typically 120ms. Power Down after measurement.
0x23 OnceLResMode — Start measurement at 4lx resolution. Typically 16ms. Power Down after measurement.

## Licence text in the file
Copyright (C) 2020 Google Inc. Licensed under the Apache License, Version 2.0 (the "License"); you may not use this file except in compliance with the License. You may obtain a copy of the License at http://www.apache.org/licenses/LICENSE-2.0 Unless required by applicable law or agreed to in writing, software distributed under the License is distributed on an "AS IS" BASIS, WITHOUT WARRANTIES OR CONDITIONS OF ANY KIND, either express or implied. See the License for the specific language governing permissions and limitations under the License.
